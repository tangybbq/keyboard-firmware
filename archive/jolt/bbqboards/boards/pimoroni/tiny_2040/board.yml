## archive/jolt/bbqboards/boards/shields/proto2/Kconfig.shield
```kconfig
# Copyright (c) 2023 Linaro Limited
# SPDX-License-Identifier: Apache-2.0

config SHIELD_PROTO2
	def_bool $(shields_list_contains,proto2)
```

## jolt/bbqboards/boards/pimoroni/tiny_2040/Kconfig.pimoroni_tiny_2040
```kconfig
# Copyright (c) 2021 Pete Johanson
# SPDX-License-Identifier: Apache-2.0

config BOARD_PIMORONI_TINY_2040
	select SOC_RP2040
	select HAS_COVERAGE_SUPPORT
```

## jolt/bbqboards/boards/shields/highboard/Kconfig.shield
```kconfig
# Copyright (c) 2023 Linaro Limited
# SPDX-License-Identifier: Apache-2.0

config SHIELD_HIGHBOARD
	def_bool $(shields_list_contains,highboard)
```

## jolt/bbqboards/boards/shields/jolt1/Kconfig.shield
```kconfig
# Copyright (c) 2023 Linaro Limited
# SPDX-License-Identifier: Apache-2.0

config SHIELD_JOLT1
	def_bool $(shields_list_contains,jolt1)
```

## jolt/bbqboards/boards/shields/jolt2/Kconfig.shield
```kconfig
# Copyright (c) 2024 Linaro Limited
# SPDX-License-Identifier: Apache-2.0

config SHIELD_JOLT2
	def_bool $(shields_list_contains,jolt2)
```

## jolt/bbqboards/boards/shields/jolt2dir/Kconfig.shield
```kconfig
# Copyright (c) 2024 Linaro Limited
# SPDX-License-Identifier: Apache-2.0

config SHIELD_JOLT2DIR
	def_bool $(shields_list_contains,jolt2dir)
```

## jolt/bbqboards/boards/shields/jolt3_mez_2040/Kconfig.shield
```kconfig
# Copyright (c) 2024 Linaro Limited
# SPDX-License-Identifier: Apache-2.0

config SHIELD_JOLT3_MEZ_2040
	def_bool $(shields_list_contains,jolt3_mez_2040)
```

## jolt/bbqboards/dts/bindings/bbq,board-info.yaml
```yaml
# Copyright 2026 Google LLC
# SPDX-License-Identifier: Apache-2.0

description: |
  Fixed-location board information block stored in flash.

  This node describes a small region containing encoded board identity
  information such as the board name and split side.

compatible: "bbq,board-info"

include: [base.yaml]

properties:
  reg:
    type: array
    required: true
    description: |
      Address and size of the board information block.
```

## jolt/bbqboards/dts/bindings/gpio-mode-selector.yaml
```yaml
# Binding for mode selector

description: |
  A GPIO used to perform some kind of mode selection.

compatible: "gpio-mode-selector"

properties:
  in-gpios:
    type: phandle-array
    required: true
    description: |
      The GPIO(s) used for the mode selection.
```
