## CMakeLists.txt
```
cmake_minimum_required(VERSION 3.20.0)

find_package(Zephyr REQUIRED HINTS $ENV{ZEPHYR_BASE})
project(zbbq)

FILE(GLOB app_sources src/*.c)
target_sources(app PRIVATE ${app_sources})

# Build stragety for a Rust 'main' application. There are a few constraints that
# cargo places on us that require a bit of trickery to get around. First,
# anything that can affect the compilation, such as config values need to be
# given to the invocation of cargo. This can be done either through the command
# line, or through files such as `.cargo/config.toml`, which is first searched
# for in the source directory. Because there are potential limits on the length
# of the command line (as well as the environment), we'll need to use the
# `.cargo/config.toml`. To make this work, we will create a fresh source
# directory in the build directory, and populate it with some of the files
# necessary to build. The `Cargo.toml` file will come from the user's app
# directory. The source files will be populated to match those in the source
# directory, using the include compiler directive within Rust. This tree will
# mirror the source tree. Then the `.cargo/config.toml` will be configured for
# this particular build. Specifically, the target directory, the target itself,
# and a mapping of Zephyr Kconfig values onto config features to rustc.

message(STATUS "RS directory: ${ZEPHYR_RS_MODULE_DIR}")
if(NOT DEFINED ZEPHYR_RS_MOUDLE_DIR)
  # TODO: Why does this check not work?
  # message(FATAL_ERROR "Unable to find zephyr-rs module")
endif()

# Map Zephyr targets to LLVM targets.
if(CONFIG_CPU_CORTEX_M)
  if(CONFIG_CPU_CORTEX_M0 OR CONFIG_CPU_CORTEX_M0PLUS OR CONFIG_CPU_CORTEX_M1)
    set(RUST_TARGET "thumbv6m-none-eabi")
  elseif(CONFIG_CPU_CORTEX_M3)
    set(RUST_TARGET "thumbv7m-none-eabi")
  elseif(CONFIG_CPU_CORTEX_M4)
    if(CONFIG_ARMV7_M_FP)
      set(RUST_TARGET "thumbv7m-none-eabi")
    else()
      set(RUST_TARGET "thumbv7em-none-eabihf")
    endif()
  elseif(CONFIG_CPU_CORTEX_M23)
    set(RUST_TARGET "thumbv8m.base-none-eabi")
  elseif(CONFIG_CPU_CORTEX_M33 OR CONFIG_CPU_CORTEX_M55)
    # Not a typo, Zephyr, uses ARMV7_M_ARMV8_M_FP to select the FP even on v8m.
    if(CONFIG_ARMV7_M_FP)
      set(RUST_TARGET "thumbv8m.main-none-eabihf")
    else()
      set(RUST_TARGET "thumbv8m.main-none-eabi")
    endif()

    # Todo: The M55 is thumbv8.1m.main-none-eabi, which can be added when Rust
    # gain support for this target.
  else()
    message(FATAL_ERROR "Unknown Cortex-M target.")
  endif()
else()
  message(FATAL_ERROR "Add support for other target")
endif()

# TODO: Make sure RUSTFLAGS is not set.
# TODO: Create source directory.
# TODO: Copy source Cargo.toml
# TODO: Mirror source tree
# TODO: Synthesize .cargo/config.toml
# TODO: Convert Kconfig entries from Zephyr into Rust configs.

set(RUST_BUILD_TYPE debug)

set(BUILD_LIB_DIR ${CMAKE_CURRENT_SOURCE_DIR}/${RUST_TARGET}/debug)

set(CARGO_TARGET_DIR ${CMAKE_CURRENT_BINARY_DIR}/rust/target-kbbq)
set(RUST_LIBRARY ${CARGO_TARGET_DIR}/${RUST_TARGET}/${RUST_BUILD_TYPE}/libkbbq.a)
set(SAMPLE_CARGO_CONFIG ${CMAKE_CURRENT_BINARY_DIR}/rust/sample-cargo-config.toml)

# The shield selected distinguishes the 2-row and 3-row keyboards. Note that the
# only way to specify features for the top level build is through the command
# line. As such, the packages may not be built with the correct features if
# cargo is invoked directly. Cmake should rerun the cargo build with the right
# arguments, though, so builds should be correct. The default feature can be set
# in Cargo.toml.
if(NOT DEFINED SHIELD)
  message(FATAL_ERROR "Must select a shield to build the keyboard firmware.")
endif()
if(SHIELD STREQUAL "proto2")
  set(SHIELD_FEATURE "proto2")
elseif(SHIELD STREQUAL "proto3")
  set(SHIELD_FEATURE "proto3")
elseif(SHIELD STREQUAL "proto4")
  set(SHIELD_FEATURE "proto2")
else()
  message(FATAL_ERROR "SHIELD is unexpected value: ${SHIELD}")
endif()

# Getting CMake to always run Cargo is a bit of a mess. The trick is to make the
# custom command's output file be a file that never gets created. This will
# cause this to always rerun the cargo command. We add the actual library as a
# BYPRODUCTS list of this command, otherwise, the first time, the link will fail
# because it doesn't think it knows how to build the library. This will also
# cause the relink when the cargo command actually does rebuild the rust code.

set(DUMMY_FILE "${CMAKE_BINARY_DIR}/always-run-cargo.dummy")

# Build a list of crate overrides, both for the .cargo config template and for the command line.
set(command_paths)
set(config_paths "")
message(STATUS "Processing crates: ${ZEPHYR_RS_MODULES}")
foreach(module IN LISTS ZEPHYR_RS_MODULES)
  message(STATUS "module: ${module}")
  set(config_paths
    "${config_paths}\
${module}.path = \"${ZEPHYR_RS_MODULE_DIR}/${module}\"
")
  list(APPEND command_paths
     "--config"
     "patch.crates-io.${module}.path=\\\"${ZEPHYR_RS_MODULE_DIR}/${module}\\\""
   )
endforeach()

# Write out a cargo config file that can be copied into `.cargo/config.toml` in
# the source directory to allow various IDE tools and such to work. The build we
# invoke will override these settings, in case they are out of date. Everything
# set here should match the arguments given to the cargo build command below.
file(WRITE ${SAMPLE_CARGO_CONFIG} "
# This is a generated sample .cargo/config.toml file from the Zephyr file
# At the time of generation, this represented the settings needed to allow
# a `cargo build` to compile the rust code using the current Zephyr build.
# If any settings in the Zephyr build change, this could become out of date.
[build]
target = \"${RUST_TARGET}\"
target-dir = \"${CARGO_TARGET_DIR}\"

[env]
BUILD_DIR = \"${CMAKE_CURRENT_BINARY_DIR}\"
DOTCONFIG = \"${DOTCONFIG}\"
ZEPHYR_DTS = \"${ZEPHYR_DTS}\"

[patch.crates-io]
${config_paths}
")

# The library can be built by just invoking Cargo
add_custom_command(
  OUTPUT ${DUMMY_FILE}
  BYPRODUCTS ${RUST_LIBRARY}
  COMMAND
    ${CMAKE_EXECUTABLE}
    env BUILD_DIR=${CMAKE_CURRENT_BINARY_DIR}
    DOTCONFIG=${DOTCONFIG}
    ZEPHYR_DTS=${ZEPHYR_DTS}
    cargo build
    # TODO: release flag if release build
    # --release

    # Override the features according to the shield given. For a general case,
    # this will need to come from a variable or argument.
    --no-default-features
    --features ${SHIELD_FEATURE}

    # Set a replacement so that packages can just use `zephyr-sys` as a package
    # name to find it.
    ${command_paths}
    --target ${RUST_TARGET}
    --target-dir ${CARGO_TARGET_DIR}
  COMMENT "Building Rust application"
  WORKING_DIRECTORY ${CMAKE_CURRENT_SOURCE_DIR}
)

add_custom_target(libkbbq ALL
  DEPENDS ${DUMMY_FILE}
)

# Link. The allow multiple definition avoids at least fatal link errors with
# definitions coming from both libgcc.a and the application built by Rust.
# See: https://github.com/rust-lang/compiler-builtins/issues/345
target_link_libraries(app PUBLIC -Wl,--allow-multiple-definition ${RUST_LIBRARY})

# Make sure this is always built.
add_dependencies(app libkbbq)
```

## prj.conf
```kconfig
# This application is in Rust.
CONFIG_RUST=y

# Log using the Segger RTT debugger.
CONFIG_LOG_BACKEND_RTT=y
CONFIG_USE_SEGGER_RTT=y
CONFIG_LOG=y

# Make the logging a little better for interactive use.
CONFIG_LOG_RUNTIME_FILTERING=y
CONFIG_LOG_BUFFER_SIZE=2048
CONFIG_LOG_PRINTK=y
CONFIG_LOG_PROCESS_TRIGGER_THRESHOLD=0

# For now, enable debugging. This will disable inlining and make the code easier
# to debug.
CONFIG_DEBUG=y

# Rust main will need a bit more stack.
# CONFIG_MAIN_STACK_SIZE=4096
CONFIG_MAIN_STACK_SIZE=8192

# Enable the GPIO driver.
CONFIG_GPIO=y

# Enable USB to get our HID device and such.
CONFIG_USB_DEVICE_STACK=y
CONFIG_USB_DEVICE_PRODUCT="bbq keyboard"
CONFIG_USB_DEVICE_PID=0x4201
CONFIG_USB_DEVICE_INITIALIZE_AT_BOOT=n

# Enable USB device wakeup, so that we can wake the host.
CONFIG_USB_DEVICE_REMOTE_WAKEUP=y

CONFIG_USB_DRIVER_LOG_LEVEL_WRN=y
CONFIG_USB_CDC_ACM_LOG_LEVEL_WRN=y

# Something weird happens if this is enabled, as it seems to mess up logging
# from my thread, which likely happens right after this log message.
CONFIG_USB_HID_LOG_LEVEL_WRN=y

CONFIG_USB_DEVICE_HID=y
CONFIG_USB_HID_DEVICE_COUNT=1

# CONFIG_UART_RPI_PICO=y
CONFIG_CONSOLE=n

CONFIG_SERIAL=y
CONFIG_UART_LINE_CTRL=y

# Enable the 2812-style LEDs.
CONFIG_LED_STRIP=y
CONFIG_LED_STRIP_LOG_LEVEL_DBG=y

# Use the 2040's PIO for the LED
CONFIG_WS2812_STRIP_RPI_PICO_PIO=y
```

## app.overlay
```dts
/* Bring in the CDC UARTs. */
 &zephyr_udc0 {
        cdc_acm_uart0 {
                compatible = "zephyr,cdc-acm-uart";
        };
        cdc_acm_uart1 {
                compatible = "zephyr,cdc-acm-uart";
        };
};
```

## boards/pimoroni_tiny_2040.overlay
```dts
/* Device tree overlay for Proto2 keyboard matrix
 * This needs to be better specialized to allow multiple boards.
 * We are using the gpio-kbd-matrix definition, because it works for what we need,
 * but if it becomes divergent, we can make our own.
 */

/ {
	aliases {
		matrix = &kbd_matrix;
	};

	chosen {
		zephyr,matrix = &kbd_matrix;
	};

	kbd_matrix: kbd-matrix {
		compatible = "gpio-kbd-matrix";
		row-gpios = <&gpio0 0 (GPIO_PULL_DOWN | GPIO_ACTIVE_HIGH)>,
			    <&gpio0 1 (GPIO_PULL_DOWN | GPIO_ACTIVE_HIGH)>,
			    <&gpio0 2 (GPIO_PULL_DOWN | GPIO_ACTIVE_HIGH)>;
		col-gpios = <&gpio0 6 GPIO_ACTIVE_HIGH>,
			    <&gpio0 7 GPIO_ACTIVE_HIGH>,
			    <&gpio0 26 GPIO_ACTIVE_HIGH>,
			    <&gpio0 27 GPIO_ACTIVE_HIGH>,
			    <&gpio0 28 GPIO_ACTIVE_HIGH>;
		col-drive-inactive;
		idle-mode = "scan";
	};
};
```

## src/main.c
```c
// C Main for zbbq firmware.
//
// This code is primarily written in Rust, but as we're just beginning with Rust
// bindings, there will be various pieces of code in this file to glue them
// together, including invoking the `rust_main` entry.

#include "zephyr/kernel/thread_stack.h"
#include "zephyr/sys/time_units.h"
#include <zephyr/kernel.h>
#include <stdlib.h>

#define LOG_LEVEL 4
#include <zephyr/logging/log.h>
LOG_MODULE_REGISTER(zbbq);

extern void rust_main(void);
extern int usb_setup(void);

extern void steno_thread_main(void *p1, void *p2, void *p3);
extern void led_thread_main(void *p1, void *p2, void *p3);
extern void init_queues(void);
extern void init_led_state(void);

#define STENO_THREAD_STACK_SIZE 8192
K_THREAD_STACK_DEFINE(steno_thread_stack, STENO_THREAD_STACK_SIZE);
struct k_thread steno_thread;

#define LED_THREAD_STACK_SIZE 1024
K_THREAD_STACK_DEFINE(led_thread_stack, LED_THREAD_STACK_SIZE);
struct k_thread led_thread;

int main(void) {
	// Initialize the queues used to communicate.
	init_queues();
	init_led_state();

	LOG_INF("cycles per s: %d\n", sys_clock_hw_cycles_per_sec());

	int ret = usb_setup();
	if (ret != 0) {
		return ret;
	}

	// Start the lower priority steno thread, which will do the dictionary
	// lookups.
	(void) k_thread_create(&steno_thread,
			       steno_thread_stack,
			       STENO_THREAD_STACK_SIZE,
			       steno_thread_main,
			       0, 0, 0,
			       5, 0, K_NO_WAIT);

	// The LED thread will write to the LEDs. The led strip driver on the
	// rp2040 is currently blocking and polled. Unfortunately, if the thread
	// is preempted, the LED's won't be programmed correctly, so we run this
	// as a non-preemptable thread. This typically takes 200-300us, so
	// shouldn't disrupt the regular scanning, too much.
	(void) k_thread_create(&led_thread,
			       led_thread_stack,
			       LED_THREAD_STACK_SIZE,
			       led_thread_main,
			       0, 0, 0,
			       -2, 0, K_NO_WAIT);

	rust_main();
}

/// Panic coming from the Rust side.
/// TODO: Pass in information about the context.
void c_k_panic() {
	k_panic();
}

/// Log a message from the Rust side.
void c_log_message(int level, const char *text) {
	// The log levels in Zephyr aren't numbers, although they are.
	switch (level) {
        case LOG_LEVEL_ERR:
		LOG_ERR("%s", text);
		break;
        case LOG_LEVEL_WRN:
		LOG_WRN("%s", text);
		break;
        case LOG_LEVEL_INF:
		LOG_INF("%s", text);
		break;
        case LOG_LEVEL_DBG:
	default:
		LOG_DBG("%s", text);
		break;
	}
}

K_TIMER_DEFINE(heartbeat_timer, NULL, NULL);
K_MUTEX_DEFINE(event_queue_mutex);
K_CONDVAR_DEFINE(event_queue_condvar);
K_MUTEX_DEFINE(steno_queue_mutex);
K_CONDVAR_DEFINE(steno_queue_condvar);

K_TIMER_DEFINE(led_timer, NULL, NULL);
K_MUTEX_DEFINE(led_mutex);

// Structure size matching.
const size_t struct_k_mutex_size = sizeof(struct k_mutex);
```

## src/gpios.c
```c
// GPIO to devicetree bindings.

#include "zephyr/devicetree.h"
#include <zephyr/kernel.h>
#include <zephyr/drivers/gpio.h>

/// GPIO expansions for the keyboard matrix.
/// This exports:
/// - matrix_rows: An array of `gpio_dt_spec *` for each row pin.
/// - n_matrix_rows: How many row pins.
/// - matrix_cols: An array of `gpio_dt_spec *` for each col pin.
/// - n_matrix_cols: How many col pins.

#define MATRIX DT_ALIAS(matrix)

#define ROW(node, prop, idx) \
	static const struct gpio_dt_spec row ## idx = GPIO_DT_SPEC_GET_BY_IDX(node, prop, idx);
DT_FOREACH_PROP_ELEM_SEP(MATRIX, row_gpios, ROW, (;));
#undef ROW

#define COL(node, prop, idx) \
	static const struct gpio_dt_spec col ## idx = GPIO_DT_SPEC_GET_BY_IDX(node, prop, idx);
DT_FOREACH_PROP_ELEM_SEP(MATRIX, col_gpios, COL, (;));
#undef COL

#define ROW(node, prop, idx) &row ## idx,
const struct gpio_dt_spec *matrix_rows[] = {
	DT_FOREACH_PROP_ELEM(MATRIX, row_gpios, ROW)
};
const uint32_t n_matrix_rows = DT_PROP_LEN(MATRIX, row_gpios);
#undef ROW

#define COL(node, prop, idx) &col ## idx,
const struct gpio_dt_spec *matrix_cols[] = {
	DT_FOREACH_PROP_ELEM(MATRIX, col_gpios, COL)
};
#undef COL
const uint32_t n_matrix_cols = DT_PROP_LEN(MATRIX, col_gpios);

/// The matrix might have a reverse scan.
const uint32_t matrix_reverse = DT_PROP(MATRIX, reverse_scan);

const char* matrix_translate =
#if DT_NODE_HAS_PROP(MATRIX, translate)
	DT_PROP(MATRIX, translate)
#else
	NULL
#endif
	;

/// GPIO for the side select detect.
#define SIDE_SELECT DT_PATH(side_select)
#if DT_NODE_EXISTS(SIDE_SELECT)
static const struct gpio_dt_spec side_select = GPIO_DT_SPEC_GET(SIDE_SELECT, in_gpios);

const struct gpio_dt_spec *c_get_side_select(void)
{
	return &side_select;
}
#else
const struct gpio_dt_spec *c_get_side_select(void)
{
	return NULL;
}
#endif
```

## src/leds.c
```c
// Binding for LEDs.

#include <zephyr/kernel.h>
#include <zephyr/drivers/led_strip.h>

#define STRIP_NODE DT_ALIAS(led_strip)
const uint32_t strip_length = DT_PROP(STRIP_NODE, chain_length);
const struct device *const strip = DEVICE_DT_GET(STRIP_NODE);

int sys_led_strip_update_rgb(const struct device *dev,
			     struct led_rgb *pixels,
			     size_t num_pixels)
{
	return led_strip_update_rgb(dev, pixels, num_pixels);
}
```

## src/uart.c
```c
// Uart device suppport.

#include <zephyr/devicetree.h>
#include <zephyr/kernel.h>
#include <zephyr/drivers/uart.h>
#include <zephyr/sys/ring_buffer.h>

// The presence of the inter-board-uart is determined by whether this chosen
// node is present.

// Note that UART writing is blocking.  As such, we use the IRQ interface.  But,
// we don't actually need the interrupts to be enabled, since our messages fit
// comfortably within the FIFO on the UART.

#if DT_HAS_CHOSEN(inter_board_uart)

#define INTER_UART DT_CHOSEN(inter_board_uart)
static const struct device *uart = DEVICE_DT_GET
	(INTER_UART);

#if 0
// This is some legacy attempts to use the irq mode.  This isn't actually
// necessary for us, though.
RING_BUF_DECLARE(inter_ring, 64);

uint8_t ubugs[1024];
int ubug_len = 0;

// Irq handler. For received data, just sticks it in the ring.  For transmit,
// does nothing.
static void inter_uart_isr(const struct device *dev, void *user_data)
{
	ARG_UNUSED(user_data);

	uart_irq_update(dev);

	if (!uart_irq_rx_ready(dev)) {
		return;
	}

	for (;;) {
		uint8_t *data;
		uint32_t size;

		size = ring_buf_put_claim(&inter_ring, &data, 32);
		if (size == 0) {
			// Ring is full, so ignore stuff.
			// k_panic();
			break;
		}

		int got = uart_fifo_read(dev, data, size);
		if (got <= 0) {
			ring_buf_put_finish(&inter_ring, 0);
			break;
		}

		uint8_t *tmppos = data;
		uint32_t tmpsize = got;
		while (ubug_len < 1024 && tmpsize > 0) {
			ubugs[ubug_len++] = *tmppos++;
			tmpsize--;
		}

		ring_buf_put_finish(&inter_ring, got);
	}
}
#endif

int inter_uart_poll_in(unsigned char *p_char)
{
	uint32_t got;

	got = uart_fifo_read(uart, p_char, 1);
	if (got == 1) {
		return 0;
	} else {
		return -1;
	}
	/*
	// TODO: We should probably be more efficient here.
	uint32_t got;

	got = ring_buf_get(&inter_ring, p_char, 1);

	if (got == 1) {
		return 0;
	} else {
		return -1;
	}
	// return uart_poll_in(uart, p_char);
	*/
}

void inter_uart_poll_out(unsigned char out_char)
{
	// Try sending the character, discard if not sent.  It is important to
	// not block.
	uart_fifo_fill(uart, &out_char, 1);
}

void inter_uart_setup(void)
{
	uart_irq_rx_disable(uart);
	uart_irq_tx_disable(uart);

	// uart_irq_callback_set(uart, inter_uart_isr);

	// Drain the fifo.
	uint8_t ch;
	while (uart_fifo_read(uart, &ch, 1) == 1) {
	}

	// uart_irq_rx_enable(uart);
}

#else // DT_NODE_EXISTS(INTER_UART)

int inter_uart_poll_in(unsigned char *p_char)
{
	(void) p_char;
	return -1;
}

void inter_uart_poll_out(unsigned char out_char)
{
	(void) out_char;
}

void inter_uart_setup(void)
{
}

#endif
```

## src/usb.c
```c
// C Main for zbbq firmware.
//
// This code is primarily written in Rust, but as we're just beginning with Rust
// bindings, there will be various pieces of code in this file to glue them
// together, including invoking the `rust_main` entry.

#include "zephyr/drivers/usb/usb_dc.h"
#include "zephyr/usb/class/hid.h"
#include <zephyr/kernel.h>

#include <zephyr/usb/usb_device.h>
#include <zephyr/usb/class/usb_hid.h>

#include <zephyr/drivers/uart.h>

#include <zephyr/logging/log.h>
LOG_MODULE_DECLARE(zbbq);

K_SEM_DEFINE(usb_sem, 1, 1);
const struct device *hid0_dev;

#define DEVICE_AND_COMMA(node_id) DEVICE_DT_GET(node_id),
const struct device *cdc_dev[] = {
		DT_FOREACH_STATUS_OKAY(zephyr_cdc_acm_uart, DEVICE_AND_COMMA)
};
#undef DEVICE_AND_COMMA

// Check that we aren't in an isr context.  To quickly catch problems.
#define NO_ISR()                                                               \
  do {                                                                         \
    if (k_is_in_isr()) {                                                       \
      k_panic();                                                               \
    }                                                                          \
  } while (0)


// Callbacks from USB.
static void in_ready_cb(const struct device *dev)
{
	NO_ISR();
	// LOG_INF("HID in_ready");
	k_sem_give(&usb_sem);
}

// TO RUST: Indicates if the USB-HID is accepting of a keypress.
int is_hid_accepting(void) {
	return k_sem_count_get(&usb_sem) > 0;
}

// TO RUST: Send the given report (8 bytes) to the hid interface.  Assumes that
// `is_hid_accepting` is available (will stall if not).
void hid_report(uint8_t *report) {
	k_sem_take(&usb_sem, K_FOREVER);
	hid_int_ep_write(hid0_dev, report, 8, NULL);
}

static const struct hid_ops ops = {
	.int_in_ready = in_ready_cb,
};

// Use a basic keyboard HID report for boot mode.  As long as we aren't doing
// NKRO, this should be adequate.
static const uint8_t hid_kbd_report_desc[] = HID_KEYBOARD_REPORT_DESC();

extern void rust_usb_status(uint32_t);

static void status_cb(enum usb_dc_status_code status, const uint8_t *param)
{
	NO_ISR();
	// Currently, we only care about configured and suspend, which we will
	// pass to the Rust code.
	switch (status) {
	case USB_DC_CONFIGURED:
		rust_usb_status(0);
		break;
	case USB_DC_SUSPEND:
		rust_usb_status(1);
		break;
	case USB_DC_RESUME:
		rust_usb_status(2);
	default:
		break;
	}
	// LOG_INF("USB status: %d", status);
}

void acm_write(int index, const uint8_t *buf, int len)
{
	const struct device *dev = cdc_dev[index];

	uint32_t ctrl;
	int res = uart_line_ctrl_get(dev, UART_LINE_CTRL_DTR, &ctrl);
	// LOG_INF("uart dtr: %d, res=%d", ctrl, res);

	// If DTS is not asserted, it means that nobody is attached to the ACM
	// endpoint.  Don't try sending, or keys will queue up.
	if (res != 0 || !ctrl) {
		return;
	}

	uart_irq_tx_enable(dev);
	while (len) {
		int written = uart_fifo_fill(dev, buf, len);
		if (written != len) {
			LOG_INF("Not written: %d", written);
		}
		break;
	}

	uart_irq_tx_disable(dev);
}

// Indicates if the given ACM device has DTR asserted.
int acm_has_dtr(int index)
{
	const struct device *dev = cdc_dev[index];

	uint32_t ctrl;
	int res = uart_line_ctrl_get(dev, UART_LINE_CTRL_DTR, &ctrl);

	return res == 0 && ctrl;
}

int usb_setup(void) {
	hid0_dev = device_get_binding("HID_0");
	if (hid0_dev == NULL) {
		LOG_ERR("Cannot get USB HID 0 Device");
		return 0;
	}

	for (int idx = 0; idx < ARRAY_SIZE(cdc_dev); idx++) {
		if (!device_is_ready(cdc_dev[idx])) {
			LOG_ERR("CDC ADM DEVICE %s is not ready",
				cdc_dev[idx]->name);
			return 0;
		}
	}

	usb_hid_register_device(hid0_dev, hid_kbd_report_desc,
				sizeof(hid_kbd_report_desc), &ops);
	usb_hid_init(hid0_dev);

	int ret = usb_enable(status_cb);
	if (ret != 0) {
		LOG_ERR("Failed to enable USB");
		return 0;
	}

	return 0;
}
```

## src/wrappers.c
```c
// syscall wrappers.

#include <zephyr/kernel.h>
#include <zephyr/drivers/gpio.h>
#include <zephyr/spinlock.h>

void sys_k_busy_wait(uint32_t usec_to_wait)
{
	k_busy_wait(usec_to_wait);
}

int sys_gpio_pin_configure(const struct device *port,
                           gpio_pin_t pin,
                           gpio_flags_t flags)
{
	return gpio_pin_configure(port, pin, flags);
}

int sys_gpio_pin_get(const struct device *port, gpio_pin_t pin)
{
	return gpio_pin_get(port, pin);
}

int sys_gpio_pin_set(const struct device *port, gpio_pin_t pin, int value)
{
	return gpio_pin_set(port, pin, value);
}

void sys_k_timer_start(struct k_timer *timer,
                       k_timeout_t duration,
                       k_timeout_t period)
{
	k_timer_start(timer, duration, period);
}

void sys_k_timer_stop(struct k_timer *timer)
{
	k_timer_stop(timer);
}

uint32_t sys_k_timer_status_sync(struct k_timer *timer)
{
	return k_timer_status_sync(timer);
}

// Spinlock for critical sections.
static struct k_spinlock crit_lock;

uint32_t z_crit_acquire(void)
{
	return k_spin_lock(&crit_lock).key;
}

void z_crit_release(uint32_t token)
{
	k_spinlock_key_t key;
	key.key = token;
	k_spin_unlock(&crit_lock, key);
}

int sys_mutex_lock(struct k_mutex *mutex, k_timeout_t timeout)
{
	return k_mutex_lock(mutex, timeout);
}

int sys_mutex_unlock(struct k_mutex *mutex)
{
	return k_mutex_unlock(mutex);
}

int sys_condvar_signal(struct k_condvar *condvar)
{
	return k_condvar_signal(condvar);
}

int sys_condvar_broadcast(struct k_condvar *condvar)
{
	return k_condvar_broadcast(condvar);
}

int sys_condvar_wait(struct k_condvar *condvar, struct k_mutex *mutex, k_timeout_t timeout)
{
	return k_condvar_wait(condvar, mutex, timeout);
}

uint64_t sys_cycle_get_64(void)
{
	return k_cycle_get_64();
}
```
