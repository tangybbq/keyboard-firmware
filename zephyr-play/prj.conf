## CMakeLists.txt
```
cmake_minimum_required(VERSION 3.20.0)

find_package(Zephyr REQUIRED HINTS $ENV{ZEPHYR_BASE})
project(zbbq)

FILE(GLOB app_sources src/*.c)
target_sources(app PRIVATE ${app_sources})

# Build stragety for a Rust 'main' application. There are a few constraints that
# cargo places on us that require a bit of trickery to get around. First,
# anything that can affect the compilation, such as config values need to be
# given to the invocation of cargo. This can be done either through the command
# line, or through files such as `.cargo/config.toml`, which is first searched
# for in the source directory. Because there are potential limits on the length
# of the command line (as well as the environment), we'll need to use the
# `.cargo/config.toml`. To make this work, we will create a fresh source
# directory in the build directory, and populate it with some of the files
# necessary to build. The `Cargo.toml` file will come from the user's app
# directory. The source files will be populated to match those in the source
# directory, using the include compiler directive within Rust. This tree will
# mirror the source tree. Then the `.cargo/config.toml` will be configured for
# this particular build. Specifically, the target directory, the target itself,
# and a mapping of Zephyr Kconfig values onto config features to rustc.

# TODO: Make sure RUSTFLAGS is not set.
# TODO: Create source directory.
# TODO: Copy source Cargo.toml
# TODO: Mirror source tree
# TODO: Synthesize .cargo/config.toml
# TODO: Convert Kconfig entries from Zephyr into Rust configs.

set(BUILD_LIB_DIR ${CMAKE_CURRENT_SOURCE_DIR}/thumbv6m-none-eabi/debug)

set(CARGO_TARGET_DIR ${CMAKE_CURRENT_BINARY_DIR}/rust/target-kbbq)
set(RUST_LIBRARY ${CARGO_TARGET_DIR}/thumbv6m-none-eabi/release/libkbbq.a)

# Getting CMake to always run Cargo is a bit of a mess. The trick is to make the
# custom command's output file be a file that never gets created. This will
# cause this to always rerun the cargo command. We add the actual library as a
# BYPRODUCTS list of this command, otherwise, the first time, the link will fail
# because it doesn't think it knows how to build the library. This will also
# cause the relink when the cargo command actually does rebuild the rust code.

set(DUMMY_FILE "${CMAKE_BINARY_DIR}/always-run-cargo.dummy")

# The library can be built by just invoking Cargo
add_custom_command(
  OUTPUT ${DUMMY_FILE}
  BYPRODUCTS ${RUST_LIBRARY}
  COMMAND cargo build
    --release
    --target thumbv6m-none-eabi
    --target-dir ${CARGO_TARGET_DIR}
  COMMENT "Building Rust application"
  WORKING_DIRECTORY ${CMAKE_CURRENT_SOURCE_DIR}
)

add_custom_target(libkbbq ALL
  DEPENDS ${DUMMY_FILE}
)

# Link. The allow multiple definition avoids at least fatal link errors with
# definitions coming from both libgcc.a and the application built by Rust.
# See: https://github.com/rust-lang/compiler-builtins/issues/345
target_link_libraries(app PUBLIC -Wl,--allow-multiple-definition ${RUST_LIBRARY})

# Make sure this is always built.
add_dependencies(app libkbbq)
```

## prj.conf
```kconfig
CONFIG_LOG_BACKEND_RTT=y
CONFIG_USE_SEGGER_RTT=y
CONFIG_LOG=y

CONFIG_GPIO=y

CONFIG_LOG_MODE_DEFERRED=y
# CONFIG_LOG_MODE_IMMEDIATE=y

# CONFIG_MPU=y
# CONFIG_ARM_MPU=y
# CONFIG_USERSPACE=y
CONFIG_COMMON_LIBC_MALLOC_ARENA_SIZE=8192

# CONFIG_NEWLIB_LIBC=y
# CONFIG_NEWLIB_LIBC_MIN_REQUIRED_HEAP_SIZE=0
# CONFIG_HEAP_MEM_POOL_SIZE=8192

# Debugging options for compiler.
CONFIG_DEBUG=y

CONFIG_STACK_SENTINEL=y
CONFIG_INIT_STACKS=y
# CONFIG_THREAD_STACK_INFO=y
CONFIG_MAIN_STACK_SIZE=4096

CONFIG_LOG_RUNTIME_FILTERING=y
CONFIG_LOG_BUFFER_SIZE=2048
CONFIG_LOG_PRINTK=y
CONFIG_LOG_PROCESS_TRIGGER_THRESHOLD=0
CONFIG_COVERAGE=n
CONFIG_LOG_TAG_MAX_LEN=8

# Enable the LED strip
CONFIG_LED_STRIP=y
CONFIG_LED_STRIP_LOG_LEVEL_DBG=y
CONFIG_WS2812_STRIP=y

# Use the 2040's PIO for the LED
CONFIG_WS2812_STRIP_RPI_PICO_PIO=y
```

## boards/sparkfun_pro_micro_rp2040.overlay
```dts
/* Device tree overlay for Proto2 keyboard matrix
 * This needs to be better specialized to allow multiple boards.
 * We are using the gpio-kbd-matrix definition, because it works for what we need,
 * but if it becomes divergent, we can make our own.
 */

/ {
	aliases {
		matrix = &kbd_matrix;
	};

	chosen {
		zephyr,matrix = &kbd_matrix;
	};

	kbd_matrix: kbd-matrix {
		compatible = "gpio-kbd-matrix";
		row-gpios = <&gpio0 7 (GPIO_PULL_DOWN | GPIO_ACTIVE_HIGH)>,
			    <&gpio0 26 (GPIO_PULL_DOWN | GPIO_ACTIVE_HIGH)>,
			    <&gpio0 22 (GPIO_PULL_DOWN | GPIO_ACTIVE_HIGH)>;
		col-gpios = <&gpio0 2 GPIO_ACTIVE_HIGH>,
			    <&gpio0 3 GPIO_ACTIVE_HIGH>,
			    <&gpio0 4 GPIO_ACTIVE_HIGH>,
			    <&gpio0 5 GPIO_ACTIVE_HIGH>,
			    <&gpio0 6 GPIO_ACTIVE_HIGH>;
		col-drive-inactive;
		idle-mode = "scan";
	};
};
```

## src/main.c
```c
/* My example */

#include "zephyr/sys/mpsc_pbuf.h"
#include "zephyr/syscall.h"
#include <zephyr/kernel.h>
#include <zephyr/logging/log_ctrl.h>
#include <stdlib.h>

#include <zephyr/app_memory/mem_domain.h>

#define LOG_LEVEL 4
#include <zephyr/logging/log.h>
LOG_MODULE_REGISTER(main);

#include <zephyr/drivers/led_strip.h>
#include <zephyr/drivers/gpio.h>

#define STRIP_NODE   DT_ALIAS(led_strip)
#define STRIP_NUM_PIXELS  DT_PROP(DT_ALIAS(led_strip), chain_length)

static const struct device *const strip = DEVICE_DT_GET(STRIP_NODE);

// Get the GPIOs for the keyboard matrix.  This is a little weird.
#define MATRIX DT_ALIAS(matrix)
static const struct gpio_dt_spec row1 = GPIO_DT_SPEC_GET_BY_IDX(MATRIX, row_gpios, 0);
static const struct gpio_dt_spec row2 = GPIO_DT_SPEC_GET_BY_IDX(MATRIX, row_gpios, 1);
static const struct gpio_dt_spec row3 = GPIO_DT_SPEC_GET_BY_IDX(MATRIX, row_gpios, 2);

static const struct gpio_dt_spec col1 = GPIO_DT_SPEC_GET_BY_IDX(MATRIX, col_gpios, 0);
static const struct gpio_dt_spec col2 = GPIO_DT_SPEC_GET_BY_IDX(MATRIX, col_gpios, 1);
static const struct gpio_dt_spec col3 = GPIO_DT_SPEC_GET_BY_IDX(MATRIX, col_gpios, 2);
static const struct gpio_dt_spec col4 = GPIO_DT_SPEC_GET_BY_IDX(MATRIX, col_gpios, 3);
static const struct gpio_dt_spec col5 = GPIO_DT_SPEC_GET_BY_IDX(MATRIX, col_gpios, 4);

static const struct gpio_dt_spec rows[3] = {
	row1, row2, row3,
};

static const struct gpio_dt_spec cols[5] = {
	col1, col2, col3, col4, col5,
};

struct matrix_info {
	const struct gpio_dt_spec *const rows;
	uint32_t nrows;
	const struct gpio_dt_spec *const cols;
	uint32_t ncols;
};

struct matrix_info get_matrix_info(void)
{
	struct matrix_info result = {
		.rows = rows,
		.cols = cols,
		.nrows = 3,
		.ncols = 5,
	};
	return result;
}

#if 0
static void wait_on_log_flushed(void)
{
	// Disable this.
	if (1) {
		return;
	}
	while (log_buffered_cnt()) {
		k_sleep(K_MSEC(5));
	}
}
#endif

const struct device *const get_led_strip(void) {
	return strip;
}

extern void rust_main(void *, void *, void *);

void msg_string(const char* msg)
{
	LOG_INF("%s", msg);
}

// Syscall wrappers.  These are just generated as C wrappers and later we will
// make this more efficient.
bool sys_device_is_ready(const struct device *dev)
{
	return device_is_ready(dev);
}

int sys_gpio_pin_configure(const struct device *port, gpio_pin_t pin,
                           gpio_flags_t flags)
{
	return gpio_pin_configure(port, pin, flags);
}

int sys_gpio_pin_set(const struct device *port, gpio_pin_t pin, int value) {
	return gpio_pin_set(port, pin, value);
}

int sys_gpio_pin_get(const struct device *port, gpio_pin_t pin) {
	return gpio_pin_get(port, pin);
}

void sys_k_timer_start(struct k_timer *timer, k_timeout_t duration, k_timeout_t period) {
	k_timer_start(timer, duration, period);
}

void sys_k_timer_stop(struct k_timer *timer) {
	k_timer_stop(timer);
}

void sys_k_timer_status_sync(struct k_timer *timer) {
	k_timer_status_sync(timer);
}

/// Wrapper for k_panic(), simple way to get past all of the macros.
void c_k_panic()
{
	k_panic();
}

/// Wrapper to sleep for n ms.
void c_k_sleep_ms(uint32_t ms)
{
	k_sleep(K_MSEC(ms));
}

void trampoline(void *a, void *b, void *c) {
	printk("trampoline\n");
	char *foo = malloc(32);
	printk("foo: %p\n", foo);
	free(foo);
	rust_main(a, b, c);
}

K_TIMER_DEFINE(ms_timer, NULL, NULL);

int main(void)
{
	char *foo = malloc(32);
	printk("foo: %p\n", foo);
	free(foo);
	printk("Sizeof k_timer: %d\n", sizeof(struct k_timer));

	// Verify my understanding of time.
	printk("Ticks: %d\n", (int)K_MSEC(1).ticks);

	// Fix domain.
#if 0
	struct z_app_region {
		void *bss_start;
		size_t bss_size;
	};
	extern struct z_app_region z_malloc_partition_region;
	struct k_mem_partition ptn;
	ptn.start = (uintptr_t)z_malloc_partition_region.bss_start;
	ptn.size = 8192;
	ptn.attr = K_MEM_PARTITION_P_RW_U_RW;
	int ret = k_mem_domain_add_partition(&k_mem_domain_default, &ptn);
	printk("add partition: %d\n", ret);
#endif

	// Jump to usermode for rust.
	// k_thread_user_mode_enter(rust_main, 0, 0, 0);
	k_thread_user_mode_enter(trampoline, 0, 0, 0);
	// rust_main();
#if 0
	register uint32_t sp __asm__("sp");
	extern uint32_t z_main_stack;

	// The stack usage already shows the usage before we got to this point.
	// To make this work a little better, clear out the stack, again.
	uint32_t base = (uint32_t)&z_main_stack;
	uint32_t len = sp - base;

	// Adjust the length to allow for the call to memset (and the base adjust).
	len -= 20;
	// Adjust the base to not overwrite the canary.
	base += 4;
	memset((void *)base, 0xaa, len);

        // LOG_INF("sp: %08x", sp);
        // LOG_INF("main: %08x", (uint32_t)&z_main_stack);

        // LOG_INF("Hello world, from C main");
        wait_on_log_flushed();

        rust_main();
        size_t left = 0;
        k_thread_stack_space_get(k_current_get(), &left);
        LOG_INF("after rust: %d bytes of stack used",
                CONFIG_MAIN_STACK_SIZE - left);
#endif

        // Log a periodic message.
        /*
        int count = 0;
        while (1) {
                count++;
                LOG_INF("Tick: %d", count);
                wait_on_log_flushed();
                k_sleep(K_MSEC(1000));
        }
        */
}
```
