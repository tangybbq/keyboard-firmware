## CMakeLists.txt
```
cmake_minimum_required(VERSION 3.20.0)

find_package(Zephyr REQUIRED HINTS $ENV{ZEPHYR_BASE})
project(keyboard_firmware)

rust_cargo_application()

target_include_directories(app PRIVATE src)
target_sources(app PRIVATE src/usb.c src/usbd_support.c src/platform.c src/minder_usb.c)
target_sources_ifdef(CONFIG_BT app PRIVATE src/ble.c src/minder_ble.c)
target_sources_ifdef(CONFIG_FUEL_GAUGE app PRIVATE src/battery.c)
target_sources_ifdef(CONFIG_POWEROFF app PRIVATE src/sleep.c)
target_sources_ifdef(CONFIG_MCUBOOT_IMG_MANAGER app PRIVATE src/image.c)

# The mesa3w: jolt signed for the J-Link as well as for updates.
if(CONFIG_BOOTLOADER_MCUBOOT)
  include(images.cmake)
endif()
```

## Kconfig
```
# Kconfigs for keyboards
# These can be overridden with the build config

mainmenu "Jolt keyboard firmware"

# This is only temporary until we can do build cfg based on dt nodes being present.
config JOLT_INTER
	bool "Jolt keyboard serial interlink"
	default y
	help
	  Enable the uart-based serial link between keyboards

source "Kconfig.zephyr"
```

## prj.conf
```kconfig
CONFIG_RUST=y
CONFIG_RUST_ALLOC=y

CONFIG_MAIN_STACK_SIZE=8192

CONFIG_USB_DEVICE_STACK_NEXT=y
CONFIG_USBD_HID_SUPPORT=y
CONFIG_LED=y
CONFIG_PWM=y

# For minder: Program writes the flash, and Reset reboots.
CONFIG_FLASH=y
CONFIG_REBOOT=y

# The same identity as jolt-embassy-rp's usb.rs: keyminder, TaipoTeacher and
# the hidutil key remap all find the keyboard by this VID/PID.  MAX_POWER is
# in 2 mA units, so this is embassy's 100 mA.
CONFIG_SAMPLE_USBD_MANUFACTURER="TangyBBQ"
CONFIG_SAMPLE_USBD_PRODUCT="Jolt Keyboard"
CONFIG_SAMPLE_USBD_VID=0xC0DE
CONFIG_SAMPLE_USBD_PID=0xCAFE
CONFIG_SAMPLE_USBD_MAX_POWER=50

# Enable the Segger console.
CONFIG_USE_SEGGER_RTT=y

# Use the RTT Console
CONFIG_UART_CONSOLE=n
CONFIG_RTT_CONSOLE=y
```

## app.overlay
```dts
/ {
	/* Each shield defines `board_info` where its SoC keeps the block. */
	chosen {
		board-info = &board_info;
	};

	hid_dev_0: hid_dev_0 {
		compatible = "zephyr,hid-device";
		label = "HID0";
		protocol-code = "keyboard";
		in-report-size = <8>;
		in-polling-period-us = <1000>;
	};
};
```

## src/battery.c
```c
/*
 * The battery's charge, on the boards with one.
 *
 * The devicetree's `battery` node is a composite fuel gauge over the
 * module's battery divider: it reads the cell's voltage and turns it into a
 * charge through a stock Li-po curve.  That is an estimate from voltage
 * alone.  See jolt-mesa.md, "Bluetooth on the mesa3w".
 *
 * Whether the cell is charging comes from the charger's CHG output (the
 * `charging-gpios` of `zephyr,user`), and whether USB is powering the board
 * from the nRF52840's own VBUS detector.  Charging lifts the cell's voltage,
 * so the voltage alone would claim full before it is; while charging the
 * charge is held under 100%, and once the charger has finished it is 100%.
 *
 * The cell changes slowly, so it is read once a minute, on the system
 * workqueue; the read is a single ADC sample and two pins.  Each change goes
 * to the Battery Service, which notifies a subscribed host.  The first
 * reading comes before Bluetooth is up; the service keeps it for the host to
 * read.
 */

#include <hal/nrf_power.h>
#include <zephyr/bluetooth/services/bas.h>
#include <zephyr/device.h>
#include <zephyr/drivers/fuel_gauge.h>
#include <zephyr/drivers/gpio.h>
#include <zephyr/init.h>
#include <zephyr/kernel.h>

#include <zephyr/logging/log.h>
LOG_MODULE_REGISTER(jolt_battery, LOG_LEVEL_INF);

#define BATTERY_PERIOD K_SECONDS(60)

static const struct device *const gauge = DEVICE_DT_GET(DT_NODELABEL(battery));

static const struct gpio_dt_spec charging_pin =
	GPIO_DT_SPEC_GET(DT_PATH(zephyr_user), charging_gpios);

/* Where the board's power is coming from. */
enum power {
	/* No USB: running from the cell. */
	POWER_BATTERY,
	/* USB, and the charger is charging the cell. */
	POWER_CHARGING,
	/* USB, and the charger has finished. */
	POWER_CHARGED,
};

static const char *const power_names[] = {
	[POWER_BATTERY] = "on battery",
	[POWER_CHARGING] = "charging",
	[POWER_CHARGED] = "charged",
};

static struct k_work_delayable battery_work;

/* The charge and power last reported, so that only a change is; -1 before
 * the first. */
static int last_charge = -1;
static int last_power = -1;

static enum power read_power(void)
{
	if (!nrf_power_usbregstatus_vbusdet_get(NRF_POWER)) {
		return POWER_BATTERY;
	}
	/* With no cell the charger keeps restarting, and this flickers. */
	return gpio_pin_get_dt(&charging_pin) > 0 ? POWER_CHARGING : POWER_CHARGED;
}

static void battery_handler(struct k_work *work)
{
	ARG_UNUSED(work);

	union fuel_gauge_prop_val voltage;
	union fuel_gauge_prop_val charge;
	int err = fuel_gauge_get_prop(gauge, FUEL_GAUGE_VOLTAGE_UV, &voltage);

	if (err == 0) {
		err = fuel_gauge_get_prop(gauge, FUEL_GAUGE_RELATIVE_STATE_OF_CHARGE_PCT, &charge);
	}
	if (err != 0) {
		LOG_WRN("Battery read failed: %d", err);
		goto again;
	}

	enum power power = read_power();
	int level = charge.relative_state_of_charge_pct;

	if (power == POWER_CHARGING) {
		level = MIN(level, 99);
	} else if (power == POWER_CHARGED) {
		level = 100;
	}

	if (level != last_charge || power != last_power) {
		last_charge = level;
		last_power = power;
		LOG_INF("Battery %d mV, %d%%, %s", voltage.voltage_uv / 1000, level,
			power_names[power]);
		/* Fails only to notify, before Bluetooth is up; the level is kept. */
		if (IS_ENABLED(CONFIG_BT_BAS)) {
			(void)bt_bas_set_battery_level(level);
		}
	}

again:
	k_work_reschedule(&battery_work, BATTERY_PERIOD);
}

static int battery_init(void)
{
	if (!device_is_ready(gauge)) {
		LOG_ERR("Battery gauge not ready");
		return -ENODEV;
	}
	if (!gpio_is_ready_dt(&charging_pin) ||
	    gpio_pin_configure_dt(&charging_pin, GPIO_INPUT) != 0) {
		LOG_ERR("Charge status pin not ready");
		return -ENODEV;
	}

	k_work_init_delayable(&battery_work, battery_handler);
	k_work_reschedule(&battery_work, K_NO_WAIT);
	return 0;
}

SYS_INIT(battery_init, APPLICATION, CONFIG_APPLICATION_INIT_PRIORITY);
```

## src/ble.c
```c
/*
 * Bluetooth HID, on the boards with a radio.
 *
 * A profile is one host.  Profile n is Bluetooth identity n, each with an
 * address of its own; the default identity, 0, cannot be reset, which
 * clearing a profile needs, and is unused.  Only the active profile
 * advertises, and its host gets the keyboard's reports whenever USB is not
 * configured (hid.rs decides).  The active profile is kept in settings, so it
 * survives a reset.  See jolt-mesa.md, "Bluetooth on the mesa3w".
 *
 * A profile with a bond belongs to its host: another host may connect, but
 * its pairing is refused and the link dropped, so that it can neither replace
 * the bond nor hold the one connection.  The host itself may pair again over
 * its old bond.  Clearing the profile is how it is given to a new host.
 * A host pairing on a second profile loses its bond on the first
 * (CONFIG_BT_ID_UNPAIR_MATCHING_BONDS): one host, one profile.
 *
 * Advertising and the profile commands all run on `ble_workq`, one at a time,
 * and off the system workqueue, as clearing a profile writes the flash.
 *
 * With the output held to USB, Bluetooth is off: the connection is dropped
 * and nothing advertises, so the host does not show a keyboard connected that
 * sends it nothing.  Auto or Bluetooth turns it back on.
 *
 * Pairing is Just Works: no passkey callbacks are registered, so the
 * keyboard reports no input or output capability.
 */

#include <errno.h>
#include <stdio.h>
#include <string.h>
#include <zephyr/bluetooth/bluetooth.h>
#include <zephyr/bluetooth/conn.h>
#include <zephyr/bluetooth/gap.h>
#include <zephyr/bluetooth/hci.h>
#include <zephyr/bluetooth/services/hids.h>
#include <zephyr/bluetooth/uuid.h>
#include <zephyr/kernel.h>
#include <zephyr/settings/settings.h>
#include <zephyr/sys/byteorder.h>
#include <zephyr/usb/class/hid.h>

#include <zephyr/logging/log.h>
LOG_MODULE_REGISTER(jolt_ble, LOG_LEVEL_INF);

extern void ble_ready_callback(bool ready, uint8_t profile);
extern void ble_report_done_callback(uintptr_t epoch);

/* How many profiles: identities 1 to PROFILE_COUNT.  CONFIG_BT_ID_MAX is one
 * more, and CONFIG_BT_MAX_PAIRED the same, a bond each. */
#define PROFILE_COUNT 4

BUILD_ASSERT(CONFIG_BT_ID_MAX == PROFILE_COUNT + 1, "an identity per profile, and identity 0");
BUILD_ASSERT(CONFIG_BT_MAX_PAIRED >= PROFILE_COUNT, "a bond per profile");

/* Where the active profile is kept. */
#define SETTINGS_PROFILE "jolt/ble/profile"

#define BLE_WORKQ_STACK_SIZE 2048
#define BLE_WORKQ_PRIO 10

/* `ble_send_report`'s answer when the stack is out of buffers, as against an
 * error: the report is fine and is to be sent again once some have gone out. */
#define BLE_SEND_BUSY 1

/* The same report as on USB: boot keyboard input, with the LED output report,
 * and no report ID. */
static const uint8_t hid_report_desc[] = HID_KEYBOARD_REPORT_DESC();

static K_THREAD_STACK_DEFINE(ble_workq_stack, BLE_WORKQ_STACK_SIZE);
static struct k_work_q ble_workq;

/* Set once `ble_setup` has finished, so that the profile commands know there
 * is a stack to give them to. */
static bool ble_up;

/* Whether the keyboard advertises and keeps a connection at all; cleared while
 * the output is held to USB.  Read on `ble_workq`, set by `ble_set_enabled`. */
static atomic_t ble_enabled = ATOMIC_INIT(1);

/* The profile that advertises and connects.  Only changed on `ble_workq`, and
 * by settings_load() before that starts. */
static uint8_t active_profile = 1;

static int settings_set(const char *name, size_t len, settings_read_cb read_cb, void *cb_arg)
{
	const char *next;

	if (!settings_name_steq(name, "profile", &next) || next != NULL) {
		return -ENOENT;
	}

	uint8_t profile;

	if (len != sizeof(profile)) {
		return -EINVAL;
	}

	int rc = read_cb(cb_arg, &profile, sizeof(profile));

	if (rc < 0) {
		return rc;
	}
	/* A profile from a build with more of them falls back to the first. */
	if (profile >= 1 && profile <= PROFILE_COUNT) {
		active_profile = profile;
	}
	return 0;
}

SETTINGS_STATIC_HANDLER_DEFINE(jolt_ble, "jolt/ble", NULL, settings_set, NULL, NULL);

static const struct bt_data ad[] = {
	BT_DATA_BYTES(BT_DATA_FLAGS, (BT_LE_AD_GENERAL | BT_LE_AD_NO_BREDR)),
	BT_DATA_BYTES(BT_DATA_GAP_APPEARANCE, BT_BYTES_LIST_LE16(BT_APPEARANCE_HID_KEYBOARD)),
	BT_DATA_BYTES(BT_DATA_UUID16_ALL, BT_UUID_16_ENCODE(BT_UUID_HIDS_VAL)),
};


static void hids_set_report(struct bt_conn *conn, enum bt_hids_report_type report_type,
			    uint8_t report_id, const uint8_t *data, uint16_t len)
{
	ARG_UNUSED(conn);
	ARG_UNUSED(report_type);
	ARG_UNUSED(report_id);
	ARG_UNUSED(data);
	ARG_UNUSED(len);

	/* The host's LED state; ignored, as on USB. */
}

static void hids_ctrl_point(struct bt_conn *conn, enum bt_hids_ctrl_point cmd)
{
	ARG_UNUSED(conn);

	LOG_INF("Host %s suspend", cmd == BT_HIDS_CTRL_SUSPEND ? "entering" : "leaving");
}

static const struct bt_hids_cb hids_cb = {
	.set_report = hids_set_report,
	.ctrl_point = hids_ctrl_point,
};

static const struct bt_hids_register_param hids_param = {
	.bcd_hid = 0x0111,
	.country_code = 0,
	.flags = BT_HIDS_INFO_FLAG_NORMALLY_CONNECTABLE,
	.report_map = hid_report_desc,
	.report_map_len = sizeof(hid_report_desc),
	.input_report_ids = {0},
	.output_report_ids = {0},
	.cb = &hids_cb,
};

static void count_conn(struct bt_conn *conn, void *data)
{
	ARG_UNUSED(conn);

	(*(int *)data)++;
}

static void disconnect_conn(struct bt_conn *conn, void *data)
{
	ARG_UNUSED(data);

	(void)bt_conn_disconnect(conn, BT_HCI_ERR_REMOTE_USER_TERM_CONN);
}

/* Advertise the active profile, unless Bluetooth is off, or there is a
 * connection, or one still being torn down: `recycled` comes back here once
 * it is gone. */
static void advertise(void)
{
	int conns = 0;

	if (!atomic_get(&ble_enabled)) {
		return;
	}

	bt_conn_foreach(BT_CONN_TYPE_LE, count_conn, &conns);
	if (conns != 0) {
		return;
	}

	/* The name carries the profile, "Jolt Keyboard 2", so that a host's list
	 * says which of the keyboard's entries is which.  A host reads the name
	 * from the advertisement, and once connected from the GAP Device Name,
	 * which is bt_set_name()'s. */
	static char name[CONFIG_BT_DEVICE_NAME_MAX + 1];

	snprintf(name, sizeof(name), "%s %u", CONFIG_BT_DEVICE_NAME, active_profile);
	if (bt_set_name(name) != 0) {
		LOG_WRN("Setting the name failed");
	}

	const struct bt_data sd[] = {
		BT_DATA(BT_DATA_NAME_COMPLETE, name, strlen(name)),
	};
	struct bt_le_adv_param param = BT_LE_ADV_PARAM_INIT(
		BT_LE_ADV_OPT_CONN, BT_GAP_ADV_FAST_INT_MIN_2, BT_GAP_ADV_FAST_INT_MAX_2, NULL);
	param.id = active_profile;

	int err = bt_le_adv_start(&param, ad, ARRAY_SIZE(ad), sd, ARRAY_SIZE(sd));
	if (err == -EALREADY) {
		return;
	}
	if (err != 0) {
		LOG_ERR("Advertising failed to start: %d", err);
		return;
	}
	LOG_INF("Advertising profile %u as \"%s\"", active_profile, name);
}

static void advertise_handler(struct k_work *work)
{
	ARG_UNUSED(work);

	advertise();
}

static K_WORK_DEFINE(advertise_work, advertise_handler);

/* The profile last asked for by `ble_select_profile`. */
static atomic_t select_target;

/* Make `select_target` the active profile.  Selecting the active one again
 * only makes sure it is advertising, if it is not connected.  Another one
 * drops the connection, and `recycled` advertises the new one once it is
 * gone. */
static void select_handler(struct k_work *work)
{
	ARG_UNUSED(work);

	uint8_t profile = atomic_get(&select_target);

	if (profile != active_profile) {
		(void)bt_le_adv_stop();
		active_profile = profile;
		LOG_INF("Profile %u selected", profile);
		bt_conn_foreach(BT_CONN_TYPE_LE, disconnect_conn, NULL);

		int err = settings_save_one(SETTINGS_PROFILE, &profile, sizeof(profile));

		if (err != 0) {
			LOG_ERR("Saving the profile failed: %d", err);
		}
	}
	advertise();
}

static K_WORK_DEFINE(select_work, select_handler);

/* The profiles `ble_clear_profile` has been asked to clear, a bit each. */
static atomic_t clear_mask;

static void log_bond(const struct bt_bond_info *info, void *data)
{
	char addr[BT_ADDR_LE_STR_LEN];

	bt_addr_le_to_str(&info->addr, addr, sizeof(addr));
	LOG_INF("Profile %u bonded to %s", *(uint8_t *)data, addr);
}

/* Log a profile's address, and the hosts it is bonded to. */
static void log_profile_addr(const char *what, uint8_t profile)
{
	bt_addr_le_t addrs[CONFIG_BT_ID_MAX];
	size_t count = ARRAY_SIZE(addrs);
	char addr[BT_ADDR_LE_STR_LEN];

	bt_id_get(addrs, &count);
	if (profile >= count) {
		return;
	}
	bt_addr_le_to_str(&addrs[profile], addr, sizeof(addr));
	LOG_INF("Profile %u %s %s", profile, what, addr);
	bt_foreach_bond(profile, log_bond, &profile);
}

/* Forget each profile in `clear_mask`: resetting its identity unpairs it,
 * drops its connection, and gives it a new address, so that the host's old
 * bond is simply dead rather than in the way of a new pairing.  A profile
 * cannot be reset while it advertises. */
static void clear_handler(struct k_work *work)
{
	ARG_UNUSED(work);

	atomic_val_t mask = atomic_clear(&clear_mask);

	for (uint8_t profile = 1; profile <= PROFILE_COUNT; profile++) {
		if ((mask & BIT(profile)) == 0) {
			continue;
		}
		if (profile == active_profile) {
			(void)bt_le_adv_stop();
		}

		int err = bt_id_reset(profile, NULL, NULL);

		if (err < 0) {
			LOG_ERR("Profile %u clear failed: %d", profile, err);
			continue;
		}
		log_profile_addr("cleared, now", profile);
	}
	advertise();
}

static K_WORK_DEFINE(clear_work, clear_handler);

/* Turn Bluetooth on or off, as `ble_enabled` now says. */
static void enable_handler(struct k_work *work)
{
	ARG_UNUSED(work);

	if (atomic_get(&ble_enabled)) {
		LOG_INF("Bluetooth on");
		advertise();
		return;
	}

	LOG_INF("Bluetooth off");
	(void)bt_le_adv_stop();
	bt_conn_foreach(BT_CONN_TYPE_LE, disconnect_conn, NULL);
}

static K_WORK_DEFINE(enable_work, enable_handler);

static void connected(struct bt_conn *conn, uint8_t err)
{
	if (err != 0) {
		LOG_WRN("Connection failed: 0x%02x %s", err, bt_hci_err_to_str(err));
		return;
	}

	LOG_INF("Connected %s", bt_conn_dst_str(conn));

	/* The HID Service needs an encrypted link; asking for it at once gets a
	 * bonded host encrypting, and a new one pairing, without waiting for
	 * the host to trip over a characteristic it cannot read. */
	if (bt_conn_set_security(conn, BT_SECURITY_L2) != 0) {
		LOG_ERR("Failed to request security");
	}
}

/* Given at each disconnection, for ble_power_off() to wait on. */
static K_SEM_DEFINE(disconnected_sem, 0, 1);

static void disconnected(struct bt_conn *conn, uint8_t reason)
{
	LOG_INF("Disconnected %s: 0x%02x %s", bt_conn_dst_str(conn), reason,
		bt_hci_err_to_str(reason));
	ble_ready_callback(false, 0);
	k_sem_give(&disconnected_sem);
}

/* Advertising stops when a host connects; once that connection's object is
 * free again, so that there is one to connect with, it starts again. */
static void recycled(void)
{
	k_work_submit_to_queue(&ble_workq, &advertise_work);
}

static void security_changed(struct bt_conn *conn, bt_security_t level,
			     enum bt_security_err err)
{
	if (err != 0) {
		LOG_WRN("Security failed: %s level %u: %d %s", bt_conn_dst_str(conn), level, err,
			bt_security_err_to_str(err));
		/* A link that cannot be encrypted cannot carry the HID Service,
		 * and would only keep the profile's host from connecting. */
		(void)bt_conn_disconnect(conn, BT_HCI_ERR_AUTH_FAIL);
		return;
	}

	LOG_INF("Security: %s level %u", bt_conn_dst_str(conn), level);
	if (level >= BT_SECURITY_L2) {
		struct bt_conn_info info;

		/* The profile is the connection's own identity, as
		 * `active_profile` belongs to `ble_workq`; hid.rs shows it. */
		if (bt_conn_get_info(conn, &info) != 0) {
			info.id = 0;
		}
		ble_ready_callback(true, info.id);
	}
}

/* What the host settled on, which is the host's choice: the keyboard asks
 * for its preferred parameters a few seconds after connecting, and the host
 * may take them, or not. */
static void le_param_updated(struct bt_conn *conn, uint16_t interval, uint16_t latency,
			     uint16_t timeout)
{
	ARG_UNUSED(conn);

	LOG_INF("Connection interval %u.%02u ms, latency %u, timeout %u ms",
		interval * 5 / 4, (interval * 125) % 100, latency, timeout * 10);
}

/*
 * Minder's flash work, an update or a dictionary, wants the link quick both
 * ways.  With peripheral latency 30 the keyboard, idle, listens only every
 * 31st connection event, about every 350 ms, and the host's packets wait for
 * it: a 4 KiB Program, 66 packets, took over 20 s.  So while minder hashes
 * and programs over Bluetooth, the keyboard asks the host for latency 0, and
 * asks for its usual latency again once the work has stopped for
 * MINDER_FAST_HOLD.  Each packet of a request of many counts as work too,
 * since a Program still arriving is not yet a request minder has seen.  Not
 * TaipoTeacher's key log polls, one packet each, which would otherwise hold
 * the latency off all day.  The host chooses; RTT shows what it took
 * (le_param_updated).
 */
#define MINDER_FAST_HOLD K_SECONDS(3)

/*
 * The interval these two requests ask for: 15 ms, both least and most.
 * macOS took the 11.25 ms the keyboard asks for at connecting, but turns
 * down any later request whose least is under 15 ms ("The min requested is
 * lower that the desired min: 9 < 15", in bluetoothd's log), Jolt not being
 * one of the HID devices it lets go lower.  Apple's rules allow a least of
 * 15 ms when the most is 15 ms too.  The request putting the latency back
 * asks for 15 ms as well, or it would be turned down and the link left at
 * latency 0.
 */
#define MINDER_INT 12

static atomic_t minder_fast;

static void set_params(struct bt_conn *conn, void *data)
{
	const struct bt_le_conn_param *param = data;
	int err = bt_conn_le_param_update(conn, param);

	if (err != 0 && err != -EALREADY) {
		LOG_WRN("Connection parameter update failed: %d", err);
	}
}

static void minder_fast_handler(struct k_work *work)
{
	ARG_UNUSED(work);

	struct bt_le_conn_param param = BT_LE_CONN_PARAM_INIT(
		MINDER_INT, MINDER_INT, 0, CONFIG_BT_PERIPHERAL_PREF_TIMEOUT);

	bt_conn_foreach(BT_CONN_TYPE_LE, set_params, &param);
}

static void minder_slow_handler(struct k_work *work)
{
	ARG_UNUSED(work);

	struct bt_le_conn_param param = BT_LE_CONN_PARAM_INIT(
		MINDER_INT, MINDER_INT, CONFIG_BT_PERIPHERAL_PREF_LATENCY,
		CONFIG_BT_PERIPHERAL_PREF_TIMEOUT);

	atomic_clear(&minder_fast);
	bt_conn_foreach(BT_CONN_TYPE_LE, set_params, &param);
}

static K_WORK_DEFINE(minder_fast_work, minder_fast_handler);
static K_WORK_DELAYABLE_DEFINE(minder_slow_work, minder_slow_handler);

/* Minder is doing flash work over Bluetooth: hold the latency at 0 until it
 * has stopped for MINDER_FAST_HOLD.  From jolt's thread, for a Hash or a
 * Program, and from the Bluetooth RX thread, for each packet of a request
 * of many (minder_ble.c). */
void ble_minder_busy(void)
{
	if (!ble_up) {
		return;
	}
	if (!atomic_set(&minder_fast, 1)) {
		k_work_submit_to_queue(&ble_workq, &minder_fast_work);
	}
	k_work_reschedule_for_queue(&ble_workq, &minder_slow_work, MINDER_FAST_HOLD);
}

BT_CONN_CB_DEFINE(conn_callbacks) = {
	.connected = connected,
	.disconnected = disconnected,
	.recycled = recycled,
	.le_param_updated = le_param_updated,
	.security_changed = security_changed,
};

static void pairing_complete(struct bt_conn *conn, bool bonded)
{
	LOG_INF("Paired %s, %s", bt_conn_dst_str(conn), bonded ? "bonded" : "not bonded");
}

static void pairing_failed(struct bt_conn *conn, enum bt_security_err reason)
{
	LOG_WRN("Pairing failed %s: %d %s", bt_conn_dst_str(conn), reason,
		bt_security_err_to_str(reason));
}

struct bond_check {
	const bt_addr_le_t *peer;
	bool other;
};

static void check_bond(const struct bt_bond_info *info, void *data)
{
	struct bond_check *check = data;

	if (!bt_addr_le_eq(&info->addr, check->peer)) {
		check->other = true;
	}
}

/* Refuse a pairing on a profile bonded to some other host.  The bonded host
 * pairing again is let through, to replace its own bond. */
static enum bt_security_err pairing_accept(struct bt_conn *conn,
					   const struct bt_conn_pairing_feat *const feat)
{
	ARG_UNUSED(feat);

	struct bt_conn_info info;

	if (bt_conn_get_info(conn, &info) != 0) {
		return BT_SECURITY_ERR_UNSPECIFIED;
	}

	struct bond_check check = {.peer = bt_conn_get_dst(conn), .other = false};

	bt_foreach_bond(info.id, check_bond, &check);
	if (check.other) {
		LOG_WRN("Profile %u is bonded to another host; refusing %s", info.id,
			bt_conn_dst_str(conn));
		return BT_SECURITY_ERR_PAIR_NOT_ALLOWED;
	}
	return BT_SECURITY_ERR_SUCCESS;
}

/* Only `pairing_accept`: with no passkey callbacks the keyboard still has no
 * input or output, so pairing stays Just Works. */
static const struct bt_conn_auth_cb auth_cb = {
	.pairing_accept = pairing_accept,
};

static struct bt_conn_auth_info_cb auth_info_cb = {
	.pairing_complete = pairing_complete,
	.pairing_failed = pairing_failed,
};

/* Make sure every profile's identity exists.  Identities are kept in
 * settings, so this only creates them on the first boot, or after the
 * settings were erased. */
static int ensure_identities(void)
{
	bt_addr_le_t addrs[CONFIG_BT_ID_MAX];
	size_t count = ARRAY_SIZE(addrs);

	bt_id_get(addrs, &count);
	while (count <= PROFILE_COUNT) {
		int id = bt_id_create(NULL, NULL);

		if (id < 0) {
			return id;
		}
		count = id + 1;
	}

	for (uint8_t profile = 1; profile <= PROFILE_COUNT; profile++) {
		log_profile_addr("is", profile);
	}
	return 0;
}

int ble_setup(void)
{
	int err;

	k_work_queue_start(&ble_workq, ble_workq_stack, K_THREAD_STACK_SIZEOF(ble_workq_stack),
			   BLE_WORKQ_PRIO, NULL);
	k_thread_name_set(k_work_queue_thread_get(&ble_workq), "ble_workq");

	err = bt_enable(NULL);
	if (err != 0) {
		LOG_ERR("Bluetooth init failed: %d", err);
		return err;
	}

	/* The bonds and the identities, which have to be back before the
	 * identity is looked for. */
	err = settings_load();
	if (err != 0) {
		LOG_ERR("Settings load failed: %d", err);
		return err;
	}

	err = ensure_identities();
	if (err != 0) {
		LOG_ERR("Identity create failed: %d", err);
		return err;
	}

	err = bt_conn_auth_cb_register(&auth_cb);
	if (err != 0) {
		LOG_ERR("Auth callbacks failed: %d", err);
		return err;
	}

	err = bt_conn_auth_info_cb_register(&auth_info_cb);
	if (err != 0) {
		LOG_ERR("Auth info callbacks failed: %d", err);
		return err;
	}

	err = bt_hids_register(&hids_param);
	if (err != 0) {
		LOG_ERR("HID Service register failed: %d", err);
		return err;
	}

	ble_up = true;
	k_work_submit_to_queue(&ble_workq, &advertise_work);
	return 0;
}

/* Ask for a profile, numbered from 1, to become the active one.  The work is
 * done on `ble_workq`; this only says whether there is such a profile. */
int ble_select_profile(uint8_t profile)
{
	if (!ble_up) {
		return -ENODEV;
	}
	if (profile < 1 || profile > PROFILE_COUNT) {
		return -EINVAL;
	}
	atomic_set(&select_target, profile);
	k_work_submit_to_queue(&ble_workq, &select_work);
	return 0;
}

/* Ask for a profile, numbered from 1, to be forgotten.  As for
 * `ble_select_profile`. */
int ble_clear_profile(uint8_t profile)
{
	if (!ble_up) {
		return -ENODEV;
	}
	if (profile < 1 || profile > PROFILE_COUNT) {
		return -EINVAL;
	}
	atomic_or(&clear_mask, BIT(profile));
	k_work_submit_to_queue(&ble_workq, &clear_work);
	return 0;
}

/* Turn Bluetooth off (the connection dropped, no advertising) or back on.  As
 * for `ble_select_profile`. */
int ble_set_enabled(bool enabled)
{
	if (!ble_up) {
		return -ENODEV;
	}
	atomic_set(&ble_enabled, enabled);
	k_work_submit_to_queue(&ble_workq, &enable_work);
	return 0;
}

static void power_off_conn(struct bt_conn *conn, void *data)
{
	int *count = data;

	if (bt_conn_disconnect(conn, BT_HCI_ERR_REMOTE_POWER_OFF) == 0) {
		(*count)++;
	}
}

/* Before the chip powers off (sleep.c): stop advertising, and end the
 * connection saying the keyboard is powering off, so the host lets go at
 * once rather than at the supervision timeout.  Waits, briefly, for the
 * disconnection to go out; it is never undone, as the next thing is a reset.
 * Called from jolt's own thread, never the Bluetooth stack's. */
void ble_power_off(void)
{
	int count = 0;

	if (!ble_up) {
		return;
	}
	atomic_set(&ble_enabled, 0);
	(void)bt_le_adv_stop();
	k_sem_reset(&disconnected_sem);
	bt_conn_foreach(BT_CONN_TYPE_LE, power_off_conn, &count);
	if (count > 0) {
		(void)k_sem_take(&disconnected_sem, K_MSEC(500));
	}
}

static void report_sent(struct bt_conn *conn, void *user_data)
{
	ARG_UNUSED(conn);

	ble_report_done_callback((uintptr_t)user_data);
}

/* Send an input report to the host.  The stack copies it into the
 * notification, so the buffer is free on return.  0 means `report_sent` will
 * be called, and given back `epoch`; BLE_SEND_BUSY that the report should be
 * tried again shortly; and anything else is an error. */
int ble_send_report(const uint8_t *report, uint16_t len, uintptr_t epoch)
{
	/* With one connection, every subscribed host is the host. */
	int err = bt_hids_send_report(NULL, 0, report, len, report_sent, (void *)epoch);

	if (err == -ENOMEM) {
		return BLE_SEND_BUSY;
	}
	return err;
}
```

## src/heapinfo.c
```c
/* Show heap info */

#include <zephyr/kernel.h>
#include <zephyr/sys/sys_heap.h>

// To be able to use this, the 'static' must be commented out of this declaration.
extern struct sys_heap z_malloc_heap;

void show_heap_stats(void)
{
	struct sys_memory_stats stats;

	sys_heap_runtime_stats_get(&z_malloc_heap, &stats);
	printk("Heap free: %u\n", stats.free_bytes);
	printk("    alloc: %u\n", stats.allocated_bytes);
	printk("max alloc: %u\n", stats.max_allocated_bytes);
}
```

## src/heartbeat.c
```c
// Heartbeat timer.

#include <zephyr/kernel.h>

struct k_timer heartbeat_timer;

extern void rust_heartbeat(void);

static void hb_tick(struct k_timer *timer) {
	rust_heartbeat();
}

void setup_heartbeat(void) {
	k_timer_init(&heartbeat_timer, hb_tick, NULL);
	k_timer_start(&heartbeat_timer, K_MSEC(1), K_MSEC(1));
}
```

## src/image.c
```c
/*
 * The running image, as MCUboot sees it.  See jolt-mesa.md, "Updates over
 * the air".
 *
 * MCUboot runs swap using move: an update is swapped into slot 0 on trial,
 * and swapped back out at the next reset unless the image confirms itself
 * first.  jolt confirms once a host can reach it (image.rs), since an image
 * that no host can reach is one no update can replace.  A wake from System
 * OFF is a reset, so an image that never gets that far is reverted when it
 * next wakes, at worst 15 minutes on.
 *
 * At boot this says which image is running and whether it is confirmed, for
 * the RTT log.
 *
 * Minder writes an update into slot 1 through here (minder.rs, image.rs).
 * Slot 1 is on the QSPI flash, which minder's Hash and Program address at
 * the nRF52840's mapping of it, 0x12000000 up (the `qspi_mm` region), so
 * that one address space covers both flashes.  Nothing reads it through
 * that mapping; the reads and writes go through the flash driver, which
 * wakes the chip from deep power-down for each.
 */

#include <errno.h>
#include <zephyr/devicetree.h>
#include <zephyr/dfu/mcuboot.h>
#include <zephyr/drivers/clock_control/nrf_clock_control.h>
#include <zephyr/init.h>
#include <zephyr/logging/log.h>
#include <zephyr/storage/flash_map.h>

LOG_MODULE_REGISTER(jolt_image, LOG_LEVEL_INF);

/* Slot 1's partition is on the QSPI flash chip, whose parent is the QSPI
 * controller, whose `qspi_mm` region is where the chip is mapped. */
#define SLOT1_NODE DT_NODELABEL(slot1_partition)
#define SLOT1_QSPI DT_PARENT(DT_GPARENT(SLOT1_NODE))
#define SLOT1_MAPPED (DT_REG_ADDR_BY_NAME(SLOT1_QSPI, qspi_mm) + DT_REG_ADDR(SLOT1_NODE))

BUILD_ASSERT(DT_NODE_HAS_COMPAT(SLOT1_QSPI, nordic_nrf_qspi),
	     "minder's window onto slot 1 assumes it is on the nRF QSPI flash");

/* What minder's ImageInfo reports; image.rs has the same layout. */
struct jolt_image_info {
	uint32_t slot_addr;
	uint32_t slot_size;
	uint8_t major;
	uint8_t minor;
	uint16_t revision;
	uint32_t build;
	bool confirmed;
};

static const struct flash_area *slot1(void)
{
	static const struct flash_area *fa;

	if (fa == NULL && flash_area_open(PARTITION_ID(slot1_partition), &fa) != 0) {
		fa = NULL;
	}
	return fa;
}

/* Where slot 1 is, as minder addresses it, and its size. */
void jolt_slot_region(uint32_t *addr, uint32_t *size)
{
	*addr = SLOT1_MAPPED;
	*size = DT_REG_SIZE(SLOT1_NODE);
}

/*
 * The nRF52840's QSPI corrupts what it moves to and from the flash when the
 * high frequency clock changes source during the transfer (anomaly 244),
 * and the Bluetooth controller starts the crystal for each radio event and
 * stops it after.  Zephyr's QSPI driver does nothing about it on the
 * nRF52840.  Here a 4 KiB write over Bluetooth lost its sixth 256-byte
 * page nearly every time, presumably the one programmed as the next
 * connection event came round.  So the crystal is held on around every use
 * of slot 1, and the clock cannot change under it.
 */
#define HFCLK DEVICE_DT_GET_ONE(nordic_nrf_clock_hfclk)

/* Start the crystal and wait until it runs, which takes about a
 * millisecond.  A success is matched by a hfxo_release(). */
static int hfxo_hold(void)
{
	int err = nrf_clock_control_request_sync(HFCLK, NULL, K_MSEC(100));

	return err < 0 ? err : 0;
}

static void hfxo_release(void)
{
	(void)nrf_clock_control_release(HFCLK, NULL);
}

/* Read from slot 1, at an offset into it. */
int jolt_slot_read(uint32_t offset, uint8_t *buf, size_t len)
{
	const struct flash_area *fa = slot1();
	int err;

	if (fa == NULL) {
		return -ENODEV;
	}
	err = hfxo_hold();
	if (err < 0) {
		return err;
	}
	err = flash_area_read(fa, offset, buf, len);
	hfxo_release();
	return err;
}

/* Erase a block of slot 1 and write `len` bytes at its start; the rest stays
 * erased.  The QSPI flash takes writes of a multiple of 4 bytes. */
int jolt_slot_program(uint32_t offset, const uint8_t *data, size_t len, size_t erase_size)
{
	const struct flash_area *fa = slot1();
	int err;

	if (fa == NULL) {
		return -ENODEV;
	}
	err = hfxo_hold();
	if (err < 0) {
		return err;
	}
	err = flash_area_erase(fa, offset, erase_size);
	if (err == 0 && len != 0) {
		err = flash_area_write(fa, offset, data, len);
	}
	hfxo_release();
	return err;
}

/* The running image's version and state, and where an update goes. */
int jolt_image_info(struct jolt_image_info *info)
{
	struct mcuboot_img_header header;
	int err;

	jolt_slot_region(&info->slot_addr, &info->slot_size);
	err = boot_read_bank_header(PARTITION_ID(slot0_partition), &header, sizeof(header));
	if (err) {
		return err;
	}
	info->major = header.h.v1.sem_ver.major;
	info->minor = header.h.v1.sem_ver.minor;
	info->revision = header.h.v1.sem_ver.revision;
	info->build = header.h.v1.sem_ver.build_num;
	info->confirmed = boot_is_img_confirmed();
	return 0;
}

/* Confirm the running image, if it is on trial.  Called from the executor;
 * the write is a few bytes of slot 0's trailer, and only happens once, on
 * the first boot of an update. */
void jolt_image_confirm(void)
{
	int err;

	if (boot_is_img_confirmed()) {
		return;
	}

	err = boot_write_img_confirmed();
	if (err) {
		LOG_ERR("Image confirm failed: %d; it reverts at the next reset", err);
		return;
	}
	LOG_INF("Image confirmed");
}

static int image_init(void)
{
	struct mcuboot_img_header header;
	int err;

	err = boot_read_bank_header(PARTITION_ID(slot0_partition), &header, sizeof(header));
	if (err) {
		LOG_WRN("No image header in slot 0: %d", err);
		return 0;
	}

	const struct mcuboot_img_sem_ver *ver = &header.h.v1.sem_ver;
	LOG_INF("Image %u.%u.%u+%u, %s", ver->major, ver->minor, ver->revision, ver->build_num,
		boot_is_img_confirmed() ? "confirmed" : "on trial until a host connects");
	return 0;
}

SYS_INIT(image_init, APPLICATION, CONFIG_APPLICATION_INIT_PRIORITY);
```

## src/minder_ble.c
```c
/*
 * Minder over Bluetooth: a GATT service carrying the minder protocol, beside
 * the HID Service on the same connection.  See jolt-mesa.md, "Minder over
 * Bluetooth".
 *
 * Two characteristics: the host writes requests to one, and the keyboard
 * notifies replies on the other.  Both need an encrypted link, so only a
 * bonded host reaches them.  Each write and each notification is one packet
 * of minder's packet framing: up to 64 bytes, the first the packet's sequence
 * number, with the top bit set on a message's last.  ATT keeps the boundaries
 * of writes and notifications, so a packet always arrives whole.
 *
 * As minder_usb.c does, this reassembles a request and hands Rust the whole
 * of it, and takes a whole reply from Rust and splits it.  A reply goes out
 * with at most MINDER_IN_FLIGHT notifications waiting, so that a key report
 * queued behind it waits for no more than that.  Sending, and every change
 * to a reply's state, happens on the system workqueue, where the completions
 * also run and where a notification never waits for a buffer.  A reply's
 * packets need an ATT MTU of 67; a host that has not offered that much gets
 * no reply, and a line in the log.
 */

#include <errno.h>
#include <string.h>
#include <zephyr/bluetooth/conn.h>
#include <zephyr/bluetooth/gatt.h>
#include <zephyr/bluetooth/uuid.h>
#include <zephyr/kernel.h>
#include <zephyr/logging/log.h>
#include <zephyr/sys/atomic.h>

LOG_MODULE_REGISTER(jolt_minder_ble, LOG_LEVEL_INF);

/* In minder_ble.rs. */
extern void minder_ble_read_callback(size_t len);
extern void minder_ble_write_callback(int result);

/* In ble.c. */
extern void ble_minder_busy(void);

/* Bigger than the biggest message either way, as in minder_usb.c. */
#define MINDER_BUF_SIZE 4224

/* A packet: the sequence byte, then up to 63 bytes of the message. */
#define MINDER_PACKET 64
#define MINDER_PAYLOAD (MINDER_PACKET - 1)
#define MINDER_LAST 0x80
#define MINDER_SEQ 0x7f

/* A reply's notifications waiting to go out at once. */
#define MINDER_IN_FLIGHT 2

/* How long to wait before trying a notification again when the stack had no
 * buffer for it. */
#define MINDER_RETRY K_MSEC(5)

/* The service and its characteristics: 9fa708NN-5fd7-4be9-b4c7-0e6e6fcf33f3,
 * NN 00, 01 and 02, as in the minder crate's `ble` module, which the hosts
 * use. */
#define MINDER_UUID(n)                                                                             \
	BT_UUID_128_ENCODE(0x9fa70800 + (n), 0x5fd7, 0x4be9, 0xb4c7, 0x0e6e6fcf33f3)

static const struct bt_uuid_128 minder_service_uuid = BT_UUID_INIT_128(MINDER_UUID(0));
static const struct bt_uuid_128 minder_request_uuid = BT_UUID_INIT_128(MINDER_UUID(1));
static const struct bt_uuid_128 minder_reply_uuid = BT_UUID_INIT_128(MINDER_UUID(2));

/*
 * The request being reassembled.  Only the Bluetooth RX thread writes it, in
 * write_request() and minder_disconnected(), and only while no whole request
 * is held for Rust.
 */
static uint8_t request[MINDER_BUF_SIZE];
static size_t request_len;
/* The sequence number the next packet must have, or -1 while discarding up
 * to the start of the next message. */
static int request_seq = -1;
/* A whole request, waiting for Rust to copy it. */
static atomic_t request_held;

/*
 * The reply being sent.  Rust fills `reply` and `reply_len` while it holds
 * REPLY_BUSY, and the rest belongs to the system workqueue.
 */
enum {
	/* A reply is being sent; Rust waits for its result. */
	REPLY_BUSY,
	/* Rust has handed over a new reply, not yet begun. */
	REPLY_START,
	/* The host disconnected; end the reply under way. */
	REPLY_ABORT,
};

static atomic_t reply_flags;
static uint8_t reply[MINDER_BUF_SIZE];
static size_t reply_len;
/* How much of the reply has been queued as notifications. */
static size_t reply_sent;
static uint8_t reply_seq;
static int reply_in_flight;
/* Counts replies and disconnections, so that a completion left from an
 * earlier one is not counted against this one. */
static uintptr_t reply_epoch;

static ssize_t write_request(struct bt_conn *conn, const struct bt_gatt_attr *attr,
			     const void *buf, uint16_t len, uint16_t offset, uint8_t flags);

BT_GATT_SERVICE_DEFINE(minder_svc,
	BT_GATT_PRIMARY_SERVICE(&minder_service_uuid.uuid),
	BT_GATT_CHARACTERISTIC(&minder_request_uuid.uuid,
			       BT_GATT_CHRC_WRITE | BT_GATT_CHRC_WRITE_WITHOUT_RESP,
			       BT_GATT_PERM_WRITE_ENCRYPT, NULL, write_request, NULL),
	BT_GATT_CHARACTERISTIC(&minder_reply_uuid.uuid, BT_GATT_CHRC_NOTIFY, BT_GATT_PERM_NONE,
			       NULL, NULL, NULL),
	BT_GATT_CCC(NULL, BT_GATT_PERM_READ | BT_GATT_PERM_WRITE_ENCRYPT),
);

/* The reply characteristic's value, which notifications are sent from. */
#define REPLY_ATTR (&minder_svc.attrs[4])

static ssize_t write_request(struct bt_conn *conn, const struct bt_gatt_attr *attr,
			     const void *buf, uint16_t len, uint16_t offset, uint8_t flags)
{
	ARG_UNUSED(conn);
	ARG_UNUSED(attr);
	ARG_UNUSED(flags);

	const uint8_t *packet = buf;

	if (offset != 0 || len < 1 || len > MINDER_PACKET) {
		return BT_GATT_ERR(BT_ATT_ERR_INVALID_ATTRIBUTE_LEN);
	}
	if (atomic_get(&request_held)) {
		/* The host sent another request without waiting for the reply
		 * to the last, which the protocol never does. */
		LOG_WRN("Minder request while one is waiting; dropped");
		request_seq = -1;
		return len;
	}

	uint8_t seq = packet[0] & MINDER_SEQ;

	if (seq == 0) {
		request_len = 0;
		request_seq = 0;
	}
	if (seq != request_seq) {
		request_seq = -1;
		return len;
	}
	if (request_len + (len - 1) > sizeof(request)) {
		LOG_WRN("Minder request too big; dropped");
		request_seq = -1;
		return len;
	}

	memcpy(&request[request_len], &packet[1], len - 1);
	request_len += len - 1;

	if (packet[0] & MINDER_LAST) {
		request_seq = -1;
		atomic_set(&request_held, 1);
		minder_ble_read_callback(request_len);
	} else {
		/* The size check ends a message long before the sequence
		 * number could wrap. */
		request_seq++;
		/* A request of many packets, a Program, comes much faster
		 * with the latency off, and minder.rs only turns it off once
		 * a whole request is in: so each packet holds it off too,
		 * or the 3 s hold runs out while a Program is still
		 * arriving.  Not the last packet, so that the one-packet
		 * key log polls never turn it on. */
		ble_minder_busy();
	}
	return len;
}

/* Copy out the request held, and let the next one in. */
size_t minder_ble_read_copy(uint8_t *dst, size_t cap)
{
	size_t len = MIN(request_len, cap);

	memcpy(dst, request, len);
	atomic_clear(&request_held);
	return len;
}

static void reply_work_handler(struct k_work *work);

static K_WORK_DELAYABLE_DEFINE(reply_work, reply_work_handler);

static void reply_finish(int result)
{
	atomic_clear_bit(&reply_flags, REPLY_BUSY);
	minder_ble_write_callback(result);
}

static void reply_sent_cb(struct bt_conn *conn, void *user_data)
{
	ARG_UNUSED(conn);

	if ((uintptr_t)user_data != reply_epoch || !atomic_test_bit(&reply_flags, REPLY_BUSY)) {
		return;
	}
	reply_in_flight--;
	if (reply_sent == reply_len && reply_in_flight == 0) {
		reply_finish(0);
		return;
	}
	k_work_reschedule(&reply_work, K_NO_WAIT);
}

static void find_conn(struct bt_conn *conn, void *data)
{
	struct bt_conn **found = data;

	if (*found == NULL) {
		*found = bt_conn_ref(conn);
	}
}

/* Queue as much of the reply as the in-flight limit allows. */
static void reply_send(void)
{
	struct bt_conn *conn = NULL;

	bt_conn_foreach(BT_CONN_TYPE_LE, find_conn, &conn);
	if (conn == NULL || !bt_gatt_is_subscribed(conn, REPLY_ATTR, BT_GATT_CCC_NOTIFY)) {
		reply_finish(-ENOTCONN);
		goto out;
	}
	if (bt_gatt_get_mtu(conn) < MINDER_PACKET + 3) {
		LOG_WRN("Minder needs an ATT MTU of %u, the host offered %u", MINDER_PACKET + 3,
			bt_gatt_get_mtu(conn));
		reply_finish(-EMSGSIZE);
		goto out;
	}

	/* `reply_sent == reply_len` once the last packet is queued; an empty
	 * reply, which CBOR never makes, would still send its one packet. */
	while (reply_in_flight < MINDER_IN_FLIGHT && (reply_sent < reply_len || reply_seq == 0)) {
		size_t chunk = MIN(MINDER_PAYLOAD, reply_len - reply_sent);
		bool last = reply_sent + chunk == reply_len;
		uint8_t packet[MINDER_PACKET];

		packet[0] = reply_seq | (last ? MINDER_LAST : 0);
		memcpy(&packet[1], &reply[reply_sent], chunk);

		struct bt_gatt_notify_params params = {
			.attr = REPLY_ATTR,
			.data = packet,
			.len = chunk + 1,
			.func = reply_sent_cb,
			.user_data = (void *)reply_epoch,
		};
		int err = bt_gatt_notify_cb(conn, &params);

		if (err == -ENOMEM) {
			k_work_reschedule(&reply_work, MINDER_RETRY);
			break;
		}
		if (err != 0) {
			reply_finish(err);
			break;
		}
		reply_sent += chunk;
		reply_seq = (reply_seq + 1) & MINDER_SEQ;
		reply_in_flight++;
		if (last) {
			break;
		}
	}

out:
	if (conn != NULL) {
		bt_conn_unref(conn);
	}
}

static void reply_work_handler(struct k_work *work)
{
	ARG_UNUSED(work);

	if (atomic_test_and_clear_bit(&reply_flags, REPLY_ABORT)) {
		/* Completions still to come belong to the connection that
		 * went.  A reply handed over since finds out for itself. */
		reply_epoch++;
		if (atomic_test_bit(&reply_flags, REPLY_BUSY) &&
		    !atomic_test_bit(&reply_flags, REPLY_START)) {
			reply_finish(-ENOTCONN);
		}
	}
	if (atomic_test_and_clear_bit(&reply_flags, REPLY_START)) {
		reply_epoch++;
		reply_sent = 0;
		reply_seq = 0;
		reply_in_flight = 0;
	}
	if (atomic_test_bit(&reply_flags, REPLY_BUSY)) {
		reply_send();
	}
}

/* Send a reply.  0 means minder_ble_write_callback() will be called with the
 * result; anything else is an error, and it will not be. */
int minder_ble_write(const uint8_t *src, size_t len)
{
	if (len > sizeof(reply)) {
		return -EMSGSIZE;
	}
	if (atomic_test_and_set_bit(&reply_flags, REPLY_BUSY)) {
		return -EBUSY;
	}
	memcpy(reply, src, len);
	reply_len = len;
	atomic_set_bit(&reply_flags, REPLY_START);
	k_work_reschedule(&reply_work, K_NO_WAIT);
	return 0;
}

static void minder_disconnected(struct bt_conn *conn, uint8_t reason)
{
	ARG_UNUSED(conn);
	ARG_UNUSED(reason);

	/* A request half received is gone with the host.  One held whole is
	 * left for Rust, whose reply then fails. */
	request_seq = -1;
	atomic_set_bit(&reply_flags, REPLY_ABORT);
	k_work_reschedule(&reply_work, K_NO_WAIT);
}

BT_CONN_CB_DEFINE(minder_conn_callbacks) = {
	.disconnected = minder_disconnected,
};
```

## src/platform.c
```c
/*
 * Platform services for the Rust side that have no Rust binding yet.
 */

#include <errno.h>
#include <stddef.h>
#include <stdint.h>
#include <zephyr/device.h>
#include <zephyr/drivers/flash.h>
#include <zephyr/drivers/hwinfo.h>
#include <zephyr/sys/reboot.h>

#if defined(CONFIG_SOC_SERIES_RP2040)
#include <hardware/structs/rosc.h>
#else
#include <zephyr/random/random.h>
#endif

/*
 * The device's unique ID.  On the RP2040 this is the flash's 64-bit unique ID,
 * the same 8 bytes jolt-embassy-rp reads with `blocking_unique_id`.  Returns
 * the number of bytes written, or a negative errno.
 */
int jolt_device_id(uint8_t *id, size_t len)
{
	return hwinfo_get_device_id(id, len);
}

/*
 * A number that differs from one boot to the next, for minder's boot_id.  It
 * only has to differ from the last run, not be unpredictable.
 *
 * On the RP2040, the ROSC's random bit, as embassy-rp's RoscRng reads it: the
 * RP2040 has no Zephyr entropy driver, and Zephyr's clock setup leaves the
 * ROSC running.  Elsewhere, Zephyr's random source, which on the nRF52840 is
 * seeded from its hardware RNG (CONFIG_ENTROPY_GENERATOR).
 */
uint64_t jolt_boot_id(void)
{
	uint64_t id = 0;

#if defined(CONFIG_SOC_SERIES_RP2040)
	for (int i = 0; i < 64; i++) {
		id = (id << 1) | (rosc_hw->randombit & 1U);
	}
#else
	sys_rand_get(&id, sizeof(id));
#endif

	return id;
}

/*
 * Erase the `erase_size` bytes of flash at `offset` (from the start of the
 * flash device), and write `len` bytes of `data` there.  On the RP2040 both
 * run with interrupts locked, as the code they would interrupt runs from
 * flash.
 */
int jolt_flash_program(uint32_t offset, const uint8_t *data, size_t len, size_t erase_size)
{
	const struct device *flash = DEVICE_DT_GET(DT_CHOSEN(zephyr_flash_controller));
	int err;

	if (!device_is_ready(flash)) {
		return -ENODEV;
	}

	err = flash_erase(flash, offset, erase_size);
	if (err || len == 0) {
		return err;
	}

	return flash_write(flash, offset, data, len);
}

/* Reset the whole chip. */
void jolt_reboot(void)
{
	sys_reboot(SYS_REBOOT_COLD);
}
```

## src/pwm.c
```c
/* Interfacing with Zephyr's PWM driver.
 */

#include <zephyr/device.h>
#include <zephyr/devicetree.h>
#include <zephyr/kernel.h>
#include <zephyr/drivers/led.h>

// TODO: Make this conditional.
// TODO: Interface this through DT in Rust.

#define LED_PWM_NODE_ID DT_COMPAT_GET_ANY_STATUS_OKAY(pwm_leds)

const char *led_label[] = {
	DT_FOREACH_CHILD_SEP_VARGS(LED_PWM_NODE_ID, DT_PROP_OR, (,), label, NULL)
};

struct pwm_led_info {
	const struct device *dev;
	uint32_t count;
};

struct pwm_led_info get_pwm(void) {
	struct pwm_led_info info;

	info.dev = DEVICE_DT_GET(LED_PWM_NODE_ID);
	if (!device_is_ready(info.dev)) {
		info.dev = 0;
		info.count = 0;
		return info;
	}

	info.count = ARRAY_SIZE(led_label);

	return info;
}

// Manual wrapper.
int pwm_set_brightness(const struct device *dev, uint32_t index, uint8_t value) {
	return led_set_brightness(dev, index, value);
}
```

## src/qspi_off.c
```c
/*
 * The XIAO nRF52840's QSPI flash (a P25Q16H) is unused: minder writes the
 * nRF52840's own flash.  Left alone it sits in standby, which is several uA
 * on the battery around the clock, in System OFF as well, since its supply
 * stays on.  Its deep power-down is a fraction of that.  The driver only
 * enters it as a PM suspend, so suspend it once at boot and never resume it.
 * The driver's init takes the chip out of deep power-down, so a reset, or a
 * wake from System OFF, comes back through here.
 */

#include <zephyr/device.h>
#include <zephyr/init.h>
#include <zephyr/logging/log.h>
#include <zephyr/pm/device.h>

LOG_MODULE_REGISTER(jolt_qspi, LOG_LEVEL_INF);

#define QSPI_FLASH DT_INST(0, nordic_qspi_nor)

static int qspi_off_init(void)
{
	const struct device *flash = DEVICE_DT_GET(QSPI_FLASH);
	int err;

	if (!device_is_ready(flash)) {
		LOG_WRN("QSPI flash not ready; left in standby");
		return 0;
	}

	err = pm_device_action_run(flash, PM_DEVICE_ACTION_SUSPEND);
	if (err) {
		LOG_WRN("QSPI flash power-down failed: %d", err);
	}
	return 0;
}

SYS_INIT(qspi_off_init, APPLICATION, CONFIG_APPLICATION_INIT_PRIORITY);
```
