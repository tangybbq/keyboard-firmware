## jolt/bbqboards/boards/shields/mesa3/Kconfig.shield
```kconfig
# Copyright (c) 2026 Linaro Limited
# SPDX-License-Identifier: Apache-2.0

config SHIELD_MESA3
	def_bool $(shields_list_contains,mesa3)
```

## jolt/bbqboards/boards/shields/mesa3w/Kconfig.shield
```kconfig
# Copyright (c) 2026 Linaro Limited
# SPDX-License-Identifier: Apache-2.0

config SHIELD_MESA3W
	def_bool $(shields_list_contains,mesa3w)
```
